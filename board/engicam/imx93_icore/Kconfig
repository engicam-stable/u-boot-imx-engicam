## board/engicam/imx93_icore/Kconfig
```kconfig
if TARGET_IMX93_ICORE

config SYS_BOARD
	default "imx93_icore"

config SYS_VENDOR
	default "engicam"

config SYS_CONFIG_NAME
	default "imx93_icore"

config IMX93_ICORE
	bool "Using LPDDR4X Timing and PMIC voltage"
	default n
	select IMX9_LPDDR4X
	help
	  Select the LPDDR4X timing and 0.6V VDDQ

config IMX93_ICORE_1GB
	bool "Using LPDDR4X Timing for 1GB RAM and PMIC voltage"
	default n
	select IMX9_LPDDR4X_1GB
	help
	  Select the LPDDR4X timing for 1GB RAM and 0.6V VDDQ

endif
```
